## config/west.yml
```yaml
manifest:
  remotes:
    - name: zmkfirmware
      url-base: https://github.com/zmkfirmware
    - name: cormoran
      url-base: https://github.com/cormoran
    - name: caksoylar
      url-base: https://github.com/caksoylar
    - name: daniel2887
      url-base: https://github.com/daniel2887
    - name: potkc
      url-base: https://github.com/poTKC
  projects:
    # DYA Studio (Custom Studio Protocol) 対応の ZMK / Zephyr
    - name: zmk
      remote: cormoran
      revision: main+dya
      import:
        file: app/west.yml
    - name: zephyr
      remote: cormoran
      revision: v4.1.0+zmk-fixes+nrf-half-duplex-uart
      clone-depth: 1
      import:
        name-blocklist:
          - ci-tools
          - hal_altera
          - hal_cypress
          - hal_infineon
          - hal_microchip
          - hal_nxp
          - hal_openisa
          - hal_xtensa
          - hal_st
          - hal_ti
          - loramac-node
          - mcuboot
          - mcumgr
          - net-tools
          - openthread
          - edtt
          - trusted-firmware-m

    # DYA Studio 拡張モジュール
    - name: zmk-feature-custom-settings
      remote: cormoran
      revision: main
    - name: zmk-feature-fast-keymap
      remote: cormoran
      revision: main
    - name: zmk-feature-runtime-macro
      remote: cormoran
      revision: main
    # コンボが16個を超えると DYA Studio のコンボ一覧でクラッシュする不具合の修正版
    - name: zmk-feature-runtime-combo
      remote: potkc
      revision: 6816dafc18c5d01ce29589e2350529914a903990
    - name: zmk-feature-input-stream
      remote: cormoran
      revision: main
    - name: zmk-feature-module-physical-layout
      remote: cormoran
      revision: main
    - name: zmk-module-runtime-input-processor
      remote: cormoran
      revision: main
    - name: zmk-driver-pmw3610-with-custom-studio-rpc
      remote: cormoran
      revision: main
    - name: zmk-module-ble-management
      remote: cormoran
      revision: main
    - name: zmk-module-settings-rpc
      remote: cormoran
      revision: main
    - name: zmk-feature-device-info
      remote: cormoran
      revision: main
    - name: zmk-feature-watchdog
      remote: cormoran
      revision: main
    - name: zmk-feature-kscan-diagnostics
      remote: cormoran
      revision: main

    # その他のモジュール
    - name: zmk-rgbled-widget
      remote: caksoylar
      revision: main
    # oleksandrmaslov/zmk-pointing-acceleration に Zephyr 4.1 向けビルド修正 1 行を加えたフォーク
    - name: zmk-pointing-acceleration
      remote: daniel2887
      revision: c926cc4ef5e0569919eda8ab2693aee3a3f2c078
  self:
    path: config
```
